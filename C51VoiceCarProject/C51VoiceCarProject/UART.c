#include "UART.h"

/******************************************************************************/
/* 函数名称  : UART_Init              		  	        	                  */
/* 函数描述  : 串口初始化，利用定时器1设置9600波特率							  */	
/* 输入参数  : 无                                                             */
/* 参数描述  : 无  					                       		              */
/* 返回值    : 无                                                             */
/******************************************************************************/
void UART_Init()
{
	AUXR = 0x01;
	PCON &= 0x7F;		//波特率不倍速
	SCON = 0x50;		//8位数据,可变波特率
	TMOD &= 0x0F;		//清除定时器1模式位
	TMOD |= 0x20;		//设定定时器1为8位自动重装方式
	TL1 = 0xFD;		//设定定时初值
	TH1 = 0xFD;		//设定定时器重装值
	ET1 = 0;		//禁止定时器1中断
	TR1 = 1;		//启动定时器1
	EA = 1;
	ES = 1;
}

/******************************************************************************/
/* 函数名称  : Write_Byte              		  	        	                  */
/* 函数描述  : 写入一个字节到串口中，写完的标志是TI = 1						  */	
/* 输入参数  : byte                                                           */
/* 参数描述  : 写入一个字节			                       		              */
/* 返回值    : 无                                                             */
/******************************************************************************/
void Write_Byte(unsigned char byte)
{
	SBUF = byte;
	while(!TI);
	TI = 0;
}

/******************************************************************************/
/* 函数名称  : Write_Data              		  	        	                  */
/* 函数描述  : 利用写入一个字节的函数，实现写入一个字符串						  */	
/* 输入参数  : str                                                            */
/* 参数描述  : 字符串指针			                      		              */
/* 返回值    : 无                                                             */
/******************************************************************************/
void Write_Data(unsigned char *str)
{
	while(*str != '\0')
	{
		Write_Byte(*str);
		str++;
	}
}

/******************************************************************************/
/* 函数名称  : UART_Handle              		  	        	                  */
/* 函数描述  : 串口中断处理函数，收到一个字节或发送完一个字节，产生中断		  */	
/* 输入参数  : 无               	                                              */
/* 参数描述  : 无			 		                     		              */
/* 返回值    : 无                                                             */
/******************************************************************************/
void UART_Handle() interrupt 4
{
	unsigned char tmp;
	if(RI)
	{
		RI = 0;
		tmp = SBUF;
		switch(tmp)
		{
			case GOFORWARD:
				Go_Forward();
				Delay10ms();
			break;
			case GOBACK:
				Go_Back();
				Delay10ms();
			break;
			case GOLEFT:
				Go_Left();
				Delay10ms();
			break;
			case GORIGHT:
				Go_Right();
				Delay10ms();
			break;
		}
	}
}
